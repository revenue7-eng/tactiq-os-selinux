## conf/layer.conf
```bitbake
BBPATH .= ":${LAYERDIR}"
BBFILES += "${LAYERDIR}/recipes-*/*/*.bb ${LAYERDIR}/recipes-*/*/*.bbappend"
BBFILE_COLLECTIONS += "tactiq-selinux"
BBFILE_PATTERN_tactiq-selinux = "^${LAYERDIR}/"
BBFILE_PRIORITY_tactiq-selinux = "10"
LAYERDEPENDS_tactiq-selinux = "core selinux"
LAYERSERIES_COMPAT_tactiq-selinux = "scarthgap"
```
